/*@!Encoding:1252*/
includes
{
  
}

variables
{

}

on start
{
  
}

// Function to extract pgn from ID
word get_pgn(dword msg_id) {
    // Masking to extract the LSB 2 bytes (16 bits)
    msg_id = msg_id << 8;
    msg_id = msg_id >> 16;
    return (word) msg_id;
}

// Function to extract source address from ID
byte get_src(dword msg_id) {
    // Masking to extract the LSB 2 bytes (16 bits)
    msg_id = msg_id << 24;
    msg_id = msg_id >> 24;
    return (byte) msg_id;
}

// Filter controller msg - that is not changing and no effect from controllers
byte not_fixMsg(dword msg_id)
{
  if(get_pgn(msg_id) != 0xFC9C 
          && get_pgn(msg_id) != 0xFCA2 && get_pgn(msg_id) != 0xFCA5
          && get_pgn(msg_id) != 0xFCA1 && get_pgn(msg_id) != 0xFCA4
          && get_pgn(msg_id) != 0xFC98 && get_pgn(msg_id) != 0xFC99
          && get_pgn(msg_id) != 0xFC9D && get_pgn(msg_id) != 0xFCC2
          && get_pgn(msg_id) != 0xFC50 && get_pgn(msg_id) != 0xFC52
          && get_pgn(msg_id) != 0xFC3F && get_pgn(msg_id) != 0xFC40
          && get_pgn(msg_id) != 0xFC42 && get_pgn(msg_id) != 0xFC48
          && get_pgn(msg_id) != 0xFC49 && get_pgn(msg_id) != 0xFC4A
          && get_pgn(msg_id) != 0xFC4B && get_pgn(msg_id) != 0xFC4C
          && get_pgn(msg_id) != 0xFC4E && get_pgn(msg_id) != 0xFCC1
          && get_pgn(msg_id) != 0xFE14 && get_pgn(msg_id) != 0xFF46
          && get_pgn(msg_id) != 0xFC3C)
    return 1;
  else
    return 0;
}

// Filter controller msg - that is no effect messages from controllers
byte not_noEftMsg(dword msg_id)
{
  if(get_pgn(msg_id) != 0xFC33 && get_pgn(msg_id) != 0xFC34
    && get_pgn(msg_id) != 0xFC35 && get_pgn(msg_id) != 0xFC36
    && get_pgn(msg_id) != 0xFC38 && get_pgn(msg_id) != 0xFC3D
    && get_pgn(msg_id) != 0xFC3E && get_pgn(msg_id) != 0xFC51
    && get_pgn(msg_id) != 0xFC53 && get_pgn(msg_id) != 0xFC5A
    && get_pgn(msg_id) != 0xFC5B && get_pgn(msg_id) != 0xFC5C
    && get_pgn(msg_id) != 0xFC96 && get_pgn(msg_id) != 0xFC97
    && get_pgn(msg_id) != 0xFCA0 && get_pgn(msg_id) != 0xFCC0
    )
    return 1;
  else
    return 0;
}


// Network setup: CAN1-controller, CAN2-actuators

// forward CAN2 message to CAN1, actuator to controller
on message CAN2. *
{
    message CAN1.* m;
      if(this.dir == rx)
      {
        if(this.can == 2)
        {
          
          // ********Message filter - actuator*********
          if(get_pgn(this.id) != 0) 
          {
            m=this;
            output(m);
          }
          
        }
        
      }
    
}


